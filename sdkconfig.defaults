## sdkconfig.defaults
```kconfig
# --- Target (ESP32-S3 based on your pin config + USB JTAG) ---
CONFIG_IDF_TARGET="esp32s3"

# --- Flash ---
CONFIG_ESPTOOLPY_FLASHSIZE_16MB=y
CONFIG_ESPTOOLPY_FLASHMODE_QIO=y
CONFIG_ESPTOOLPY_FLASHFREQ_80M=y

# --- Custom partition table (needed for large firmware with embedded model) ---
CONFIG_PARTITION_TABLE_CUSTOM=y
CONFIG_PARTITION_TABLE_CUSTOM_FILENAME="partitions.csv"

# --- PSRAM (your code uses MALLOC_CAP_SPIRAM) ---
CONFIG_SPIRAM=y
CONFIG_SPIRAM_MODE_OCT=y
CONFIG_SPIRAM_SPEED_80M=y
CONFIG_SPIRAM_MALLOC_ALWAYSINTERNAL=4096
CONFIG_SPIRAM_MALLOC_RESERVE_INTERNAL=65536

# --- C++ support for ESP-DL ---
CONFIG_COMPILER_CXX_EXCEPTIONS=y
CONFIG_COMPILER_CXX_EXCEPTIONS_EMG_POOL_SIZE=0
CONFIG_COMPILER_CXX_RTTI=y

# --- Security/Hashing ---
CONFIG_MBEDTLS_ENABLED=y
CONFIG_MBEDTLS_HARDWARE_SHA=y

# --- FreeRTOS ---
CONFIG_FREERTOS_HZ=1000
CONFIG_FREERTOS_TIMER_TASK_STACK_DEPTH=4096

# --- FAT filesystem (for SD card) ---
CONFIG_FATFS_LONG_FILENAMES=y
CONFIG_FATFS_LFN_HEAP=y
CONFIG_FATFS_MAX_LFN=255

# --- Console output via USB Serial JTAG ---
CONFIG_ESP_CONSOLE_USB_SERIAL_JTAG=y

# ============================================================
# NimBLE configuration
# ============================================================
CONFIG_BT_ENABLED=y
CONFIG_BT_NIMBLE_ENABLED=y

# Only peripheral/broadcaster (we are the GATT server)
CONFIG_BT_NIMBLE_ROLE_PERIPHERAL=y
CONFIG_BT_NIMBLE_ROLE_BROADCASTER=y
CONFIG_BT_NIMBLE_ROLE_CENTRAL=n
CONFIG_BT_NIMBLE_ROLE_OBSERVER=n

# MTU 517 to fit 160-byte ECG and 78-byte vitals in one notification
CONFIG_BT_NIMBLE_ATT_PREFERRED_MTU=517

# Single connection
CONFIG_BT_NIMBLE_MAX_CONNECTIONS=1

# Pin NimBLE host task to Core 0 (keep Core 1 free for pipeline)
CONFIG_BT_NIMBLE_PINNED_TO_CORE=0
```
